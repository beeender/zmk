## app/boards/arm/chelizi/Kconfig.board
```kconfig
# chelizi board configuration

# Copyright (c) 2020 The ZMK Contributors
# SPDX-License-Identifier: MIT

config BOARD_CHELIZI
    bool "chelizi"
    depends on SOC_NRF52840_QIAA

config BOARD_CHELIZI_EINK
    bool "chelizi_eink"
    depends on SOC_NRF52840_QIAA
```

## app/boards/arm/chelizi/Kconfig.defconfig
```kconfig
# Electronut Labs Papyr board configuration

# Copyright (c) 2020 The ZMK Contributors
# SPDX-License-Identifier: MIT
config ZMK_KEYBOARD_NAME
    default "CheLiZi v2"

config BT_DEVICE_NAME
    default "CheLiZi v2"

config BOARD
    default "chelizi"

if USB_DEVICE_STACK
config USB_NRFX
    default y
endif # USB_DEVICE_STACK

config BT_CTLR
    default BT

if ZMK_DISPLAY
config ZMK_DISPLAY
    select LV_USE_LABEL
    select LV_USE_IMG
    select LV_FONT_MONTSERRAT_18
    select LV_FONT_MONTSERRAT_12
config ZMK_DISPLAY_BLANK_ON_IDLE
    default n
choice ZMK_DISPLAY_WORK_QUEUE
    default ZMK_DISPLAY_WORK_QUEUE_DEDICATED
endchoice
choice ZMK_DISPLAY_STATUS_SCREEN
    default ZMK_DISPLAY_STATUS_SCREEN_CUSTOM
endchoice

config HEAP_MEM_POOL_SIZE
    default 4096
config LV_Z_MEM_POOL_SIZE
    default 4096
config ZMK_DISPLAY_DEDICATED_THREAD_STACK_SIZE
    default 4096

endif # ZMK_DISPLAY

config QYEG0213
    default y
```

## app/module/drivers/display/Kconfig
```kconfig
# Copyright (c) 2021 The ZMK Contributors
# SPDX-License-Identifier: MIT

if DISPLAY

rsource "Kconfig.il0323"
rsource "Kconfig.qyeg0213"

endif # DISPLAY
```

## app/module/drivers/display/Kconfig.qyeg0213
```kconfig
config QYEG0213
    bool "QiYun eink display controller driver"
    help
      Enable driver for QiYun eink display controller.
```

## app/module/dts/bindings/display/qiyun,qyeg0213.yaml
```yaml
description: QiYun eink display driver.

compatible: "qiyun,qyeg0213"

include: base.yaml

properties:
  height:
    type: int
    required: true
    description: Height in pixel of the panel driven by the controller

  width:
    type: int
    required: true
    description: Width in pixel of the panel driven by the controller

  reset-gpios:
    type: phandle-array
    required: true
    description: RESET pin.

  dc-gpios:
    type: phandle-array
    required: true
    description: DC pin.

  busy-gpios:
    type: phandle-array
    required: true
    description: BUSY pin.

  sdi-gpios:
    type: phandle-array
    required: true
    description: SPI sdi pin.

  sclk-gpios:
    type: phandle-array
    required: true
    description: SPI sclk pin.

  cs-gpios:
    type: phandle-array
    required: true
    description: SPI cs pin.
```
